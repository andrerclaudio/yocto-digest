## tools/Examples/bitbake-conf/build-qemu-scarthgap-rpm/conf/bblayers.conf
```bitbake
# POKY_BBLAYERS_CONF_VERSION is increased each time build/conf/bblayers.conf
# changes incompatibly
POKY_BBLAYERS_CONF_VERSION = "2"

BBPATH = "${TOPDIR}"
BBFILES ?= ""

BBLAYERS ?= " \
  /home/builder/host/poky/meta \
  /home/builder/host/poky/meta-poky \
  /home/builder/host/poky/meta-yocto-bsp \
  /home/builder/host/meta-openembedded/meta-filesystems \
  /home/builder/host/meta-openembedded/meta-gnome \
  /home/builder/host/meta-openembedded/meta-initramfs \
  /home/builder/host/meta-openembedded/meta-multimedia \
  /home/builder/host/meta-openembedded/meta-networking \
  /home/builder/host/meta-openembedded/meta-oe \
  /home/builder/host/meta-openembedded/meta-perl \
  /home/builder/host/meta-openembedded/meta-python \
  /home/builder/host/meta-openembedded/meta-webserver \
  /home/builder/host/meta-openembedded/meta-xfce \
  /home/builder/host/yocto-digest/tools/meta-complementary \
  "
```
